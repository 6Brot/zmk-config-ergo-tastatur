## boards/shields/ergo_tastatur/Kconfig.shield
```kconfig
config SHIELD_ERGO_TASTATUR_LEFT
    def_bool $(shields_list_contains,ergo_tastatur_left)

config SHIELD_ERGO_TASTATUR_RIGHT
    def_bool $(shields_list_contains,ergo_tastatur_right)
```
